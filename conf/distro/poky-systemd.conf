## conf/distro/poky-systemd.conf
```bitbake
DISTRO = "poky-systemd"
DISTRO_NAME = "Poky/systemd"
DISTRO_VERSION = "1.0+snapshot-${DATE}"
DISTRO_CODENAME ="poky-systemd"

MAINTAINER = "Maciej Sobkowski <maciejjo@maciejjo.pl>"

TARGET_VENDOR = "-poky"

LAYER_CONF_VERSION ?= "6"

PREFERRED_PROVIDER_udev ?= "systemd"
PREFERRED_PROVIDER_udev-utils ?= "systemd"
VIRTUAL-RUNTIME_init_manager = "systemd"
VIRTUAL-RUNTIME_initscripts = ""

DISTRO_FEATURES_append = " systemd ipv4 wifi"
DISTRO_FEATURES_BACKFILL_CONSIDERED = "sysvinit"
PACKAGECONFIG_append_pn-systemd = " networkd resolved"

PACKAGE_CLASSES = "package_ipk"
```

## conf/layer.conf
```bitbake
# We have a conf and classes directory, add to BBPATH
BBPATH .= ":${LAYERDIR}"

# We have recipes-* directories, add to BBFILES
BBFILES += "${LAYERDIR}/recipes-*/*/*.bb \
	${LAYERDIR}/recipes-*/*/*.bbappend"

BBFILE_COLLECTIONS += "meta-orangutan"
BBFILE_PATTERN_meta-orangutan = "^${LAYERDIR}/"
BBFILE_PRIORITY_meta-orangutan = "6"
```
